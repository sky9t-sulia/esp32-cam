## main/Kconfig.projbuild
```kconfig
menu "ESP32-CAM configuration"

    menu "Wifi Configuration"
      config WIFI_SSID
        string "Wifi SSID"
        default "*******"
      config WIFI_PASSWORD
        string "Wifi password"
        default "*******"
    endmenu

    menu "SDMMC Configuration"

      config SDMMC_FORMAT_IF_MOUNT_FAILED
        bool "Format the card if mount failed"
        default n
        help
            If this config item is set, format_if_mount_failed will be set to true and the card will be formatted if
            the mount has failed.

      choice SDMMC_BUS_WIDTH
        prompt "SD/MMC bus width"
          default SDMMC_BUS_WIDTH_4
          help
              Select the bus width of SD or MMC interface.
              Note that even if 1 line mode is used, D3 pin of the SD card must have a pull-up resistor connected.
              Otherwise the card may enter SPI mode, the only way to recover from which is to cycle power to the card.

          config SDMMC_BUS_WIDTH_4
              bool "4 lines (D0 - D3)"

          config SDMMC_BUS_WIDTH_1
              bool "1 line (D0)"
      endchoice

      if SOC_SDMMC_USE_GPIO_MATRIX

        config SDMMC_PIN_CMD
          int "CMD pin"
          default 15
        config SDMMC_PIN_CLK
          int "CLK pin"
          default 14
        config SDMMC_PIN_DATA0
          int "DATA0 pin"
          default 2

        if SDMMC_BUS_WIDTH_4
          config SDMMC_PIN_DATA1
            int "DATA1 pin"
            default 4
          config SDMMC_PIN_DATA2
            int "DATA2 pin"
            default 12
          config SDMMC_PIN_DATA3
            int "DATA3 pin"
            default 13
        endif
      endif
    endmenu
endmenu
```
